## board/alcatel/yarisxl/Kconfig
```kconfig
if BOARD_YARISXL

config SYS_BOARD
	default "yarisxl"

config SYS_VENDOR
	default "alcatel"

config SYS_CONFIG_NAME
	default "yarisxl"

endif
```

## board/huawei/holly/Kconfig
```kconfig
if BOARD_HOLLY

config SYS_BOARD
	default "holly"

config SYS_VENDOR
	default "huawei"

config SYS_CONFIG_NAME
	default "holly"

endif
```

## board/jty/d101/Kconfig
```kconfig
if BOARD_D101

config SYS_BOARD
	default "D101"

config SYS_VENDOR
	default "jty"

config SYS_CONFIG_NAME
	default "d101"

endif
```

## board/lenovo/a369i/Kconfig
```kconfig
if BOARD_A369I

config SYS_BOARD
	default "a369i"

config SYS_VENDOR
	default "lenovo"

config SYS_CONFIG_NAME
	default "a369i"

endif
```

## configs/mt6572_defconfig
```kconfig
### Commands
CONFIG_CMD_MMC=y
CONFIG_CMD_BOOTD=y
CONFIG_CMD_BOOTM=y
CONFIG_CMD_BOOTZ=y
CONFIG_BOOTM_LINUX=y
CONFIG_CMD_BOOTMENU=y
CONFIG_CMD_FDT=y
CONFIG_CMD_GO=y
CONFIG_CMD_RUN=y
CONFIG_CMD_IMI=y
CONFIG_CMD_BDI=y
CONFIG_CMD_BDINFO_EXTRA=y
CONFIG_CMD_UFETCH=y
CONFIG_CMD_DM=y


### Drivers
## Simple Framebuffer
CONFIG_VIDEO=y
CONFIG_VIDEO_SIMPLE=y
CONFIG_CONSOLE_MUX=y
CONFIG_CONSOLE_NORMAL=y
CONFIG_DM_VIDEO=y
CONFIG_BPP_16=y
CONFIG_VIDEO_ANSI=y
CONFIG_FDT_SIMPLEFB=y
CONFIG_VIDEO_LOGO=n
CONFIG_VIDEO_DT_SIMPLEFB=y
CONFIG_SYS_WHITE_ON_BLACK=y
#CONFIG_NO_FB_CLEAR=y
CONFIG_CLK=y
CONFIG_DMA=y
CONFIG_GPIO=y
CONFIG_I2C=y
CONFIG_INPUT=y
CONFIG_IOMMU=y
CONFIG_MMC=y
CONFIG_MMC_WRITE=y
CONFIG_DM_MMC=y
CONFIG_MMC_QUIRKS=y
CONFIG_MMC_HW_PARTITIONING=y
CONFIG_SUPPORT_EMMC_BOOT=y
# CONFIG_MMC_IO_VOLTAGE is not set
# CONFIG_MMC_HS400_ES_SUPPORT is not set
CONFIG_MMC_HS400_SUPPORT=y
CONFIG_MMC_HS200_SUPPORT=y
CONFIG_MMC_VERBOSE=y
CONFIG_MMC_TRACE=y
# CONFIG_MMC_DW is not set
# CONFIG_MMC_MXC is not set
CONFIG_MMC_SDHCI=y
CONFIG_MMC_MTK=y
CONFIG_PHY=y
CONFIG_PINCTRL=y
CONFIG_PINCTRL_FULL=y
CONFIG_PINCTRL_GENERIC=y
CONFIG_PINMUX=y
CONFIG_PINCONF=y
CONFIG_PINCONF_RECURSIVE=y
CONFIG_PINCTRL_MTK=y
CONFIG_PINCTRL_MT7623=y
CONFIG_POWER=y
CONFIG_REGMAP=y
CONFIG_POWER_DOMAIN=y
#CONFIG_MTK_POWER_DOMAIN=y
CONFIG_POWER_MT6323=y
CONFIG_DM_RESET=y
CONFIG_SYSCON=y
CONFIG_RESET_MEDIATEK=y
CONFIG_RESET_SYSCON=y 
CONFIG_DM_RNG=y
CONFIG_SERIAL=y
CONFIG_BAUDRATE=921600
CONFIG_REQUIRE_SERIAL_CONSOLE=y
CONFIG_SERIAL_PRESENT=y
CONFIG_DM_SERIAL=y
CONFIG_DEBUG_UART_MTK=y
CONFIG_DEBUG_UART_SHIFT=0
#CONFIG_DEBUG_UART_SKIP_INIT=y
CONFIG_MTK_SERIAL=y
CONFIG_SYSRESET=y
CONFIG_SYSRESET_CMD_RESET=y
CONFIG_SYSRESET_WATCHDOG=y
CONFIG_TIMER=y
CONFIG_MTK_TIMER=y
CONFIG_USB=y
CONFIG_WATCHDOG=y
CONFIG_WATCHDOG_AUTOSTART=y
CONFIG_WDT=y
CONFIG_WDT_MTK=y


### Build
# 80108000-8085cfff : Kernel code
CONFIG_SYS_TEXT_BASE=0x81e00000
CONFIG_TEXT_BASE=0x81e00000
CONFIG_HAS_CUSTOM_SYS_INIT_SP_ADDR=y
CONFIG_CUSTOM_SYS_INIT_SP_ADDR=0x81ffff10
CONFIG_SYS_BOARD="mt6572"
CONFIG_SYS_CONFIG_NAME="mt6572"
CONFIG_TARGET_MT6572=y
CONFIG_SYS_SOC="mediatek"
CONFIG_SYS_VENDOR="mediatek"
CONFIG_LINUX_KERNEL_IMAGE_HEADER=y
CONFIG_ARM=y
CONFIG_SYS_ARCH="arm"
CONFIG_SYS_CPU="armv7"
CONFIG_CC_OPTIMIZE_FOR_SPEED=y
CONFIG_OPTIMIZE_INLINING=y
CONFIG_ARCH_SUPPORTS_LTO=y
CONFIG_CC_HAS_ASM_INLINE=y
CONFIG_DEFAULT_DEVICE_TREE="mt6572-lenovo-a369i"
CONFIG_DEFAULT_FDT_FILE="mt6572-lenovo-a369i.dtb"
CONFIG_MTK_BROM_HEADER_INFO="lk=1"
CONFIG_ARCH_MEDIATEK=y
CONFIG_CPU_V7A=y
CONFIG_SYS_ARM_ARCH=7
CONFIG_SYS_ARM_CACHE_WRITEBACK=y
CONFIG_SYS_THUMB_BUILD=y
CONFIG_USE_ARCH_MEMCPY=y
CONFIG_USE_ARCH_MEMSET=y


### Debugging / Logging
CONFIG_LOGLEVEL=9
CONFIG_PANIC_HANG=y
CONFIG_LOG=y
CONFIG_LOG_MAX_LEVEL=6
CONFIG_LOG_DEFAULT_LEVEL=6
CONFIG_LOG_CONSOLE=y
CONFIG_LOGF_FUNC_PAD=20
CONFIG_DEBUG_UART_BASE=0x11005000
CONFIG_DEBUG_UART_CLOCK=26000000
CONFIG_DEBUG_UART=y


### Other
CONFIG_AUTOBOOT=n
CONFIG_SUPPORT_PASSING_ATAGS=y
CONFIG_MULTI_DTB_FIT_UNCOMPRESS_SZ=0x8000
CONFIG_ANDROID_BOOT_IMAGE=y
CONFIG_MENU=y
CONFIG_SYS_CONSOLE_IS_IN_ENV=y
CONFIG_HASH=y
CONFIG_CMDLINE=y
CONFIG_HUSH_PARSER=y
CONFIG_CMDLINE_EDITING=y
CONFIG_AUTO_COMPLETE=y
CONFIG_SYS_LONGHELP=y
CONFIG_SYS_PROMPT="U-Boot => "
CONFIG_SYS_PROMPT_HUSH_PS2="> "
CONFIG_SYS_XTRACE=y
#CONFIG_SYS_MALLOC_LEN=0x400000
CONFIG_SYS_MALLOC_LEN=0x2000000
CONFIG_SYS_MALLOC_F_LEN=0x8000
CONFIG_DISTRO_DEFAULTS=y
#CONFIG_EXPERT=y
CONFIG_SYS_LOAD_ADDR=0x84000000
CONFIG_PLATFORM_ELFENTRY="_start"
CONFIG_STACK_SIZE=0x1000000
CONFIG_POSITION_INDEPENDENT=y
#CONFIG_POSITION_INDEPENDENT=n
CONFIG_HAS_VBAR=y
CONFIG_HAS_THUMB2=y
CONFIG_GPIO_EXTRA_HEADER=y
CONFIG_ARM_ASM_UNIFIED=y
CONFIG_SYS_ARM_CACHE_CP15=y
CONFIG_SYS_ARM_MMU=y


### Disabling unused stuff
CONFIG_NET=n
CONFIG_CMD_NET=n
CONFIG_EFI_LOADER=n
```

## configs/mt6580_defconfig
```kconfig
### Commands
CONFIG_CMD_MMC=y
CONFIG_CMD_BOOTD=y
CONFIG_CMD_BOOTM=y
CONFIG_CMD_BOOTZ=y
CONFIG_BOOTM_LINUX=y
CONFIG_CMD_BOOTMENU=y
CONFIG_CMD_FDT=y
CONFIG_CMD_GO=y
CONFIG_CMD_RUN=y
CONFIG_CMD_IMI=y
CONFIG_CMD_BDI=y
CONFIG_CMD_BDINFO_EXTRA=y
CONFIG_CMD_UFETCH=y
CONFIG_CMD_DM=y
CONFIG_CMD_ENV=y
CONFIG_CMD_LED=y
CONFIG_CMD_MEMINFO=y
CONFIG_CMD_MEMINFO_MAP=y

### Drivers
## MSDC
CONFIG_EFI_PARTITION=y
CONFIG_EFI_PARTITION_ENTRIES_NUMBERS=128
CONFIG_PARTITION_UUIDS=y
## Display
CONFIG_LED_MTK_PWM=y
## Other
CONFIG_DM_STDIO=y
CONFIG_CLK=y
CONFIG_DMA=y
CONFIG_GPIO=y
CONFIG_I2C=y
CONFIG_INPUT=y
CONFIG_IOMMU=y
CONFIG_MMC=y
CONFIG_MMC_WRITE=y
CONFIG_DM_MMC=y
CONFIG_MMC_QUIRKS=y
CONFIG_MMC_HW_PARTITIONING=y
CONFIG_SUPPORT_EMMC_BOOT=y
# CONFIG_MMC_IO_VOLTAGE is not set
# CONFIG_MMC_HS400_ES_SUPPORT is not set
CONFIG_MMC_HS400_SUPPORT=y
CONFIG_MMC_HS200_SUPPORT=y
CONFIG_MMC_VERBOSE=y
CONFIG_MMC_TRACE=y
# CONFIG_MMC_DW is not set
# CONFIG_MMC_MXC is not set
CONFIG_MMC_SDHCI=y
CONFIG_MMC_MTK=y
CONFIG_PHY=y
CONFIG_PINCTRL=y
CONFIG_PINCTRL_FULL=y
CONFIG_PINCTRL_GENERIC=y
CONFIG_PINMUX=y
CONFIG_PINCONF=y
CONFIG_PINCONF_RECURSIVE=y
CONFIG_PINCTRL_MTK=y
CONFIG_PINCTRL_MT7623=y
CONFIG_POWER=y
CONFIG_REGMAP=y
CONFIG_POWER_DOMAIN=y
#CONFIG_MTK_POWER_DOMAIN=y
CONFIG_POWER_MT6323=y
CONFIG_DM_RESET=y
CONFIG_SYSCON=y
CONFIG_RESET_MEDIATEK=y
CONFIG_RESET_SYSCON=y 
CONFIG_DM_RNG=y
CONFIG_SERIAL=y
CONFIG_BAUDRATE=921600
CONFIG_REQUIRE_SERIAL_CONSOLE=y
CONFIG_SERIAL_PRESENT=y
CONFIG_DM_SERIAL=y
CONFIG_DEBUG_UART_MTK=y
CONFIG_DEBUG_UART_SHIFT=0
#CONFIG_DEBUG_UART_SKIP_INIT=y
CONFIG_MTK_SERIAL=y
CONFIG_SYSRESET=y
CONFIG_SYSRESET_CMD_RESET=y
CONFIG_SYSRESET_WATCHDOG=y
CONFIG_TIMER=y
CONFIG_MTK_TIMER=y
CONFIG_USB=y
CONFIG_WATCHDOG=y
CONFIG_WATCHDOG_AUTOSTART=y
CONFIG_WDT=y
CONFIG_WDT_MTK=y


### Build
CONFIG_TEXT_BASE=0x81e00000
CONFIG_POSITION_INDEPENDENT=y
CONFIG_HAS_CUSTOM_SYS_INIT_SP_ADDR=y
CONFIG_CUSTOM_SYS_INIT_SP_ADDR=0x81ffff10
CONFIG_SYS_BOARD="mt6580"
CONFIG_SYS_CONFIG_NAME="mt6580"
CONFIG_TARGET_MT6580=y
CONFIG_SYS_SOC="mediatek"
CONFIG_SYS_VENDOR="mediatek"
CONFIG_LINUX_KERNEL_IMAGE_HEADER=y
CONFIG_ARM=y
CONFIG_SYS_ARCH="arm"
CONFIG_SYS_CPU="armv7"
CONFIG_CC_OPTIMIZE_FOR_SPEED=y
CONFIG_CC_OPTIMIZE_LIBS_FOR_SPEED=y
CONFIG_OPTIMIZE_INLINING=y
CONFIG_ARCH_SUPPORTS_LTO=y
CONFIG_CC_HAS_ASM_INLINE=y
CONFIG_DEFAULT_DEVICE_TREE="mt8321-prestigio-pmt3151"
CONFIG_DEFAULT_FDT_FILE="mt8321-prestigio-pmt3151.dtb"
CONFIG_MTK_BROM_HEADER_INFO="lk=1"
CONFIG_ARCH_MEDIATEK=y
CONFIG_CPU_V7A=y
CONFIG_SYS_ARM_ARCH=7
CONFIG_SYS_ARM_CACHE_WRITEBACK=y
CONFIG_SYS_THUMB_BUILD=y
CONFIG_USE_ARCH_MEMCPY=y
CONFIG_USE_ARCH_MEMSET=y
CONFIG_LOCALVERSION="-mt6580"


### Debugging / Logging
CONFIG_LOG=y
CONFIG_LOG_CONSOLE=y
CONFIG_LOG_DEFAULT_LEVEL=6
CONFIG_LOGLEVEL=6
CONFIG_PANIC_HANG=y
CONFIG_LOG_MAX_LEVEL=6
#CONFIG_LOGF_FILE=y
#CONFIG_LOGF_LINE=y
#CONFIG_LOGF_FUNC=y
#CONFIG_LOGF_FUNC_PAD=20
CONFIG_DEBUG_UART=y
CONFIG_DEBUG_UART_BASE=0x11005000
CONFIG_DEBUG_UART_CLOCK=26000000
CONFIG_DEBUG_UART_ANNOUNCE=y


### Other
CONFIG_HUSH_PARSER=y
CONFIG_AUTOBOOT=y
CONFIG_BOOTDELAY=2
#CONFIG_AUTOBOOT_MENU_SHOW=y
CONFIG_AUTOBOOT_KEYED=y
#CONFIG_AUTOBOOT_USE_MENUKEY
CONFIG_SUPPORT_PASSING_ATAGS=y
CONFIG_MULTI_DTB_FIT_UNCOMPRESS_SZ=0x8000
CONFIG_ANDROID_BOOT_IMAGE=y
CONFIG_MENU=y
CONFIG_SYS_CONSOLE_IS_IN_ENV=y
CONFIG_CMDLINE=y
CONFIG_CMDLINE_EDITING=y
CONFIG_AUTO_COMPLETE=y
CONFIG_SYS_LONGHELP=y
CONFIG_SYS_PROMPT="U-Boot => "
CONFIG_SYS_PROMPT_HUSH_PS2="> "
CONFIG_SYS_XTRACE=y
CONFIG_SYS_MALLOC_LEN=0x2000000
CONFIG_SYS_MALLOC_F_LEN=0x8000
#CONFIG_DISTRO_DEFAULTS=y
CONFIG_EXPERT=y
CONFIG_SYS_LOAD_ADDR=0x84000000
CONFIG_PLATFORM_ELFENTRY="_start"
CONFIG_STACK_SIZE=0x1000000
CONFIG_HAS_VBAR=y
CONFIG_HAS_THUMB2=y
CONFIG_GPIO_EXTRA_HEADER=y
CONFIG_ARM_ASM_UNIFIED=y
CONFIG_SYS_ARM_CACHE_CP15=y
CONFIG_SYS_ARM_MMU=y


### Disabling unused stuff
CONFIG_NET=n
CONFIG_CMD_NET=n
CONFIG_EFI_LOADER=n
CONFIG_CMD_ACPI=n
CONFIG_PXE_UTILS=n
```
